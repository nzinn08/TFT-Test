//File Name: gfx.cpp
//Description: This defines the implementation for the graphics fx library

//Include Files
#include "gfx.h"
#include "hspi.h"

//Defines
#ifndef _swap_int16_t
#define _swap_int16_t(a, b) { int16_t t = a; a = b; b = t; }
#endif

#ifndef abs
#define abs(x) (x < 0 ? (x * -1) : x)
#endif

#ifndef pgm_read_byte
 #define pgm_read_byte(addr) (*(const unsigned char *)(addr))
#endif
//Private Constants

//Private Variables
namespace{
    extern const unsigned char font[];
}
//Public Constants

//Public Variables

//Private Function Prototypes

//Public Function Prototypes

//Private Function Definitions

//Public Function Definitions
TFT_GFX::TFT_GFX(SPI_TypeDef *SPIx):
spiInstance{SPIx}
{}

void TFT_GFX::setAddrWindow(uint16_t x1, uint16_t y1, uint16_t w, uint16_t h)
{
    uint16_t x2 = (x1 + w - 1);
    uint16_t y2 = (y1 + h - 1);
	// Set column range.
	hspi_cmd(this->spiInstance, 0x2A);
	hspi_w16(this->spiInstance, x1);
	hspi_w16(this->spiInstance, x2);
	
	// Set row range.
	hspi_cmd(this->spiInstance, 0x2B);
	hspi_w16(this->spiInstance, y1);
	hspi_w16(this->spiInstance, y2);
	
	// Set 'write to RAM'
	hspi_cmd(this->spiInstance, 0x2C);
}

void TFT_GFX::writePixel(int16_t x, int16_t y, uint16_t color) 
{
    if((x >= 0) && (x < TFT_WIDTH) && (y >= 0) && (y < TFT_HEIGHT)) 
    {
        setAddrWindow(x, y, 1, 1);
        hspi_w16(this->spiInstance, color);
    }
}

void TFT_GFX::writeFillRect(int16_t x, int16_t y,
  int16_t w, int16_t h, uint16_t color) {
    if(w && h) {                            // Nonzero width and height?
        if(w < 0) {                         // If negative width...
            x +=  w + 1;                    //   Move X to left edge
            w  = -w;                        //   Use positive width
        }
        if(x < TFT_WIDTH) {                    // Not off right
            if(h < 0) {                     // If negative height...
                y +=  h + 1;                //   Move Y to top edge
                h  = -h;                    //   Use positive height
            }
            if(y < TFT_HEIGHT) {               // Not off bottom
                int16_t x2 = x + w - 1;
                if(x2 >= 0) {               // Not off left
                    int16_t y2 = y + h - 1;
                    if(y2 >= 0) {           // Not off top
                        // Rectangle partly or fully overlaps screen
                        if(x  <  0)       { x = 0; w = x2 + 1; } // Clip left
                        if(y  <  0)       { y = 0; h = y2 + 1; } // Clip top
                        if(x2 >= TFT_WIDTH)  { w = TFT_WIDTH  - x;   } // Clip right
                        if(y2 >= TFT_HEIGHT) { h = TFT_HEIGHT - y;   } // Clip bottom
                        writeFillRectPreclipped(x, y, w, h, color);
                    }
                }
            }
        }
    }
}

inline void TFT_GFX::writeFillRectPreclipped(int16_t x, int16_t y,
  int16_t w, int16_t h, uint16_t color) {
    setAddrWindow(x, y, w, h);
    writeColor(color, (uint32_t)w * h);
}

void TFT_GFX::writeColor(uint16_t color, uint32_t len){
	for(uint32_t i = 0; i < len; i++){
		hspi_w16(this->spiInstance, color);
	}
}

void inline TFT_GFX::writeFastVLine(int16_t x, int16_t y, int16_t h, uint16_t color) {
    if((x >= 0) && (x < TFT_WIDTH) && h) { // X on screen, nonzero height
        if(h < 0) {                     // If negative height...
            y +=  h + 1;                //   Move Y to top edge
            h  = -h;                    //   Use positive height
        }
        if(y < TFT_HEIGHT) {               // Not off bottom
            int16_t y2 = y + h - 1;
            if(y2 >= 0) {               // Not off top
                // Line partly or fully overlaps screen
                if(y  <  0)       { y = 0; h = y2 + 1; } // Clip top
                if(y2 >= TFT_HEIGHT) { h = TFT_HEIGHT - y;   } // Clip bottom
                writeFillRectPreclipped(x, y, 1, h, color);
            }
        }
    }
}

void inline TFT_GFX::writeFastHLine(int16_t x, int16_t y, int16_t w,
  uint16_t color) {
    if((y >= 0) && (y < TFT_HEIGHT) && w) { // Y on screen, nonzero width
        if(w < 0) {                      // If negative width...
            x +=  w + 1;                 //   Move X to left edge
            w  = -w;                     //   Use positive width
        }
        if(x < TFT_WIDTH) {                 // Not off right
            int16_t x2 = x + w - 1;
            if(x2 >= 0) {                // Not off left
                // Line partly or fully overlaps screen
                if(x  <  0)       { x = 0; w = x2 + 1; } // Clip left
                if(x2 >= TFT_WIDTH)  { w = TFT_WIDTH  - x;   } // Clip right
                writeFillRectPreclipped(x, y, w, 1, color);
            }
        }
    }
}

void TFT_GFX::drawChar(int16_t x, int16_t y, unsigned char c, uint16_t color, uint16_t bg, uint8_t size_x, uint8_t size_y) 
{
    if((x >= TFT_WIDTH)            || // Clip right
        (y >= TFT_HEIGHT)           || // Clip bottom
        ((x + 6 * size_x - 1) < 0) || // Clip left
        ((y + 8 * size_y - 1) < 0))   // Clip top
        return;

    if(c >= 176) c++; // Handle 'classic' charset behavior

    //startWrite();
    for(int8_t i=0; i<5; i++ ) { // Char bitmap = 5 columns
        uint8_t line = pgm_read_byte(&font[c * 5 + i]);
        for(int8_t j=0; j<8; j++, line >>= 1) {
            if(line & 1) {
                if(size_x == 1 && size_y == 1)
                    writePixel(x+i, y+j, color);
                else
                    writeFillRect(x+i*size_x, y+j*size_y, size_x, size_y, color);
            } else if(bg != color) {
                if(size_x == 1 && size_y == 1)
                    writePixel(x+i, y+j, bg);
                else
                    writeFillRect(x+i*size_x, y+j*size_y, size_x, size_y, bg);
            }
        }
    }
    if(bg != color) { // If opaque, draw vertical line for last column
        if(size_x == 1 && size_y == 1) writeFastVLine(x+5, y, 8, bg);
        else          writeFillRect(x+5*size_x, y, size_x, 8*size_y, bg);
    }
    //endWrite();
}

// Standard ASCII 5x7 font
namespace {
const unsigned char font[] = {
	0x00, 0x00, 0x00, 0x00, 0x00,
	0x3E, 0x5B, 0x4F, 0x5B, 0x3E,
	0x3E, 0x6B, 0x4F, 0x6B, 0x3E,
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	0x00, 0x00, 0x00, 0x00, 0x00  // #255 NBSP
};

}
